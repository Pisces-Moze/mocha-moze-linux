// SPDX-License-Identifier: GPL-2.0-only
/* Atmel variant confirmed by the original Ubuntu DTB and boot log.
 * Do not load firmware or write a new controller configuration on first boot.
 */
#include <dt-bindings/input/input.h>
/ {
    i2c@7000c700 {
        touchscreen@4a {
            compatible = "atmel,maxtouch";
            reg = <0x4a>;
            interrupt-parent = <&gpio>;
            interrupts = <TEGRA_GPIO(R, 7) IRQ_TYPE_EDGE_FALLING>;
            reset-gpios = <&gpio TEGRA_GPIO(K, 4) GPIO_ACTIVE_LOW>;
            vdd-supply = <&ldo3_reg>;
            vdda-supply = <&ldo3_reg>;
            linux,keycodes = <KEY_BACK KEY_HOME KEY_MENU>;
        };
    };
};
