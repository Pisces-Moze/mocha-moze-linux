// SPDX-License-Identifier: GPL-2.0-only
/* Original tegra.sh uses ttyTHS2; recovery sysfs maps it to 0x70006200.
 * Shutdown/wake GPIOs come from the original Ubuntu DTB.
 * BCM4350C0.hcd must be preserved from the device; pairing remains untested.
 */
/ {
    serial@70006200 {
        compatible = "nvidia,tegra124-hsuart", "nvidia,tegra30-hsuart";
        status = "okay";
        uart-has-rtscts;
        bluetooth {
            compatible = "brcm,bcm43540-bt";
            max-speed = <3000000>;
            shutdown-gpios = <&gpio TEGRA_GPIO(R, 1) GPIO_ACTIVE_HIGH>;
            device-wakeup-gpios = <&gpio TEGRA_GPIO(EE, 1) GPIO_ACTIVE_HIGH>;
            interrupt-parent = <&gpio>;
            interrupts = <TEGRA_GPIO(U, 6) IRQ_TYPE_EDGE_RISING>;
            interrupt-names = "host-wakeup";
        };
    };
};
